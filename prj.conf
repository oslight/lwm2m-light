## Kconfig
```
# Copyright (c) 2017 Linaro Limited
#
# SPDX-License-Identifier: Apache-2.0
#

mainmenu "Linaro FOTA configuration"

config ZEPHYR_BASE
	string
	option env="ZEPHYR_BASE"

config APPLICATION_BASE
	string
	option env="PROJECT_BASE"

source "$ZEPHYR_BASE/Kconfig.zephyr"

config FOTA_DEVICE
	bool "Enable FOTA device settings"
	default y
	select FOTA_DEVICE_SOC_SERIES_KINETIS_K6X if SOC_SERIES_KINETIS_K6X
	select FOTA_DEVICE_SOC_SERIES_NRF52X if SOC_SERIES_NRF52X
	select FOTA_DEVICE_SOC_SERIES_STM32F4X if SOC_SERIES_STM32F4X
	help
	  Main config to enable device specific settings

config FOTA_DEVICE_SOC_SERIES_KINETIS_K6X
	bool "Kinetis K6x FOTA settings"
	select NET_L2_ETHERNET
	select NET_SHELL
	select NET_IPV4
	select NET_APP_NEED_IPV4
	default n

config FOTA_DEVICE_SOC_SERIES_NRF52X
	bool "Nordic Semiconductor nRF52 FOTA settings"
	select NET_L2_BT
	select NET_L2_BT_ZEP1656
	select NET_IPV6
	select NET_APP_NEED_IPV6
	select SENSOR
	select TEMP_NRF5
	select TEST_RANDOM_GENERATOR
	select PWM_NRF5_SW
	default n

config FOTA_DEVICE_SOC_SERIES_STM32F4X
	bool "STM32F4x FOTA settings"
	select NET_L2_BT
	select NET_L2_BT_ZEP1656
	select NET_IPV6
	select NET_APP_NEED_IPV6
	select TEST_RANDOM_GENERATOR
	select PWM_STM32
	default n

config SYS_LOG_FOTA_LEVEL
	int "FOTA log level"
	depends on SYS_LOG && FOTA_DEVICE
	default 0
	range 0 4
	help
	  Set the log level for the FOTA library.

	  The available levels are:

	  - 0 OFF: do not write
	  - 1 ERROR: only write SYS_LOG_ERR
	  - 2 WARNING: write SYS_LOG_WRN in addition to previous level
	  - 3 INFO: write SYS_LOG_INF in addition to previous levels
	  - 4 DEBUG: write SYS_LOG_DBG in addition to previous levels

source "$APPLICATION_BASE/Kconfig.app"
```

## Kconfig.app
```
# Copyright (c) 2017 Linaro Limited
#
# SPDX-License-Identifier: Apache-2.0
#

config APP_PWM_WHITE
	bool
	prompt "Enable dedicated PWM for white color"
	default y

if APP_PWM_WHITE

config APP_PWM_WHITE_DEV
	string
	prompt "PWM device name used for white"

config APP_PWM_WHITE_PIN
	int
	prompt "PWM pin number used for white"
	default 0

config APP_PWM_WHITE_PIN_CEILING
	int
	prompt "PWM pin level ceiling"
	default 255
	range 1 255

endif # APP_PWM_WHITE

config APP_PWM_RED
	bool
	prompt "Enable dedicated PWM for red"
	default n

if APP_PWM_RED

config APP_PWM_RED_DEV
	string
	prompt "PWM device name used for red"

config APP_PWM_RED_PIN
	int
	prompt "PWM pin number used for red"
	default 0

config APP_PWM_RED_PIN_CEILING
	int
	prompt "PWM pin level ceiling"
	default 255
	range 1 255

endif # APP_PWM_RED

config APP_PWM_GREEN
	bool
	prompt "Enable dedicated PWM for green"
	default n

if APP_PWM_GREEN

config APP_PWM_GREEN_DEV
	string
	prompt "PWM device name used for green"

config APP_PWM_GREEN_PIN
	int
	prompt "PWM pin number used for green"
	default 0

config APP_PWM_GREEN_PIN_CEILING
	int
	prompt "PWM pin level ceiling"
	default 255
	range 1 255

endif # APP_PWM_GREEN

config APP_PWM_BLUE
	bool
	prompt "Enable dedicated PWM for blue"
	default n

if APP_PWM_BLUE

config APP_PWM_BLUE_DEV
	string
	prompt "PWM device name used for blue"

config APP_PWM_BLUE_PIN
	int
	prompt "PWM pin number used for blue"
	default 0

config APP_PWM_BLUE_PIN_CEILING
	int
	prompt "PWM pin level ceiling"
	default 255
	range 1 255

endif # APP_PWM_BLUE
```

## prj.conf
```kconfig
CONFIG_BOOT_BANNER=y
CONFIG_BUILD_TIMESTAMP=y
CONFIG_REBOOT=y
CONFIG_FLASH=y
CONFIG_NETWORKING=y

# Leave device specific settings to enable IPV*
CONFIG_NET_IPV6=n
CONFIG_NET_IPV4=n

# Network
CONFIG_NET_UDP=y
CONFIG_NET_MGMT=y
CONFIG_NET_MGMT_EVENT=y
CONFIG_NET_CONTEXT_NET_PKT_POOL=y
CONFIG_NET_RX_STACK_SIZE=2048
CONFIG_NET_PKT_RX_COUNT=10
CONFIG_NET_PKT_TX_COUNT=10
CONFIG_NET_BUF_RX_COUNT=10
CONFIG_NET_BUF_TX_COUNT=10
CONFIG_NET_BUF_DATA_SIZE=384

# General
CONFIG_MINIMAL_LIBC_EXTENDED=y

# FOTA
CONFIG_FOTA_DEVICE=y

# APP
CONFIG_APP_PWM_WHITE=y
CONFIG_APP_PWM_RED=y
CONFIG_APP_PWM_GREEN=y
CONFIG_APP_PWM_BLUE=y

# NET APP
CONFIG_NET_APP=y
CONFIG_NET_APP_INIT_TIMEOUT=0
CONFIG_NET_APP_NEED_IPV6=n
CONFIG_NET_APP_NEED_IPV4=n
CONFIG_NET_APP_CLIENT=y
CONFIG_NET_APP_SETTINGS=y
CONFIG_NET_APP_BT_NODE=y
CONFIG_BT_DEVICE_NAME="Linaro IPSP node"

# PWM
CONFIG_PWM=y
#CONFIG_SYS_LOG_PWM_LEVEL=4

# LWM2M
CONFIG_LWM2M=y
CONFIG_LWM2M_RD_CLIENT_INSTANCE_COUNT=1
CONFIG_LWM2M_ENGINE_MAX_OBSERVER=20
CONFIG_LWM2M_SERVER_INSTANCE_COUNT=2
# CONFIG_LWM2M_RW_JSON_SUPPORT is not set
CONFIG_LWM2M_COAP_BLOCK_SIZE=256
CONFIG_LWM2M_FIRMWARE_UPDATE_PULL_COAP_PROXY_SUPPORT=y
CONFIG_LWM2M_IPSO_SUPPORT=y
CONFIG_LWM2M_IPSO_TEMP_SENSOR=y
CONFIG_LWM2M_IPSO_LIGHT_CONTROL=y
CONFIG_SYS_LOG_LWM2M_LEVEL=3

# HTTP (LWM2M only uses the parser)
CONFIG_HTTP_PARSER_URL_ONLY=y

# Logging
CONFIG_SYS_LOG=y
CONFIG_SYS_LOG_SHOW_COLOR=y
CONFIG_SYS_LOG_EXT_HOOK=y
CONFIG_SYS_LOG_FOTA_LEVEL=4

# Bluetooth (when enabled) debug
#CONFIG_BT_DEBUG_LOG=y
#CONFIG_BT_DEBUG_HCI_DRIVER=y

# Add flash RW to MPU
CONFIG_MPU_ALLOW_FLASH_WRITE=y

# Debug helpers
#CONFIG_NET_LOG=y
#CONFIG_SYS_LOG_NET_LEVEL=4
#CONFIG_NET_DEBUG_CORE=y
#CONFIG_NET_DEBUG_NET_APP=y
#CONFIG_NET_DEBUG_IF=y
#CONFIG_NET_DEBUG_UTILS=y
#CONFIG_NET_DEBUG_CONTEXT=y
#CONFIG_NET_DEBUG_NET_PKT=y
#CONFIG_NET_DEBUG_NET_PKT_ALL=y
#CONFIG_NET_DEBUG_CONN=y
#CONFIG_NET_DEBUG_ROUTE=y
#CONFIG_NET_DEBUG_IPV4=y
#CONFIG_NET_DEBUG_IPV6=y
#CONFIG_NET_DEBUG_ICMPV6=y
#CONFIG_NET_DEBUG_IPV6_NBR_CACHE=y
#CONFIG_NET_DEBUG_6LO=y
#CONFIG_NET_DEBUG_UDP=y
#CONFIG_NET_DEBUG_L2_ETHERNET=y
#CONFIG_NET_DEBUG_L2_BT=y
#CONFIG_INIT_STACKS=y
#CONFIG_STACK_USAGE=y
```

## boards/96b_carbon.conf
```kconfig
# network stack settings
CONFIG_NET_IF_UNICAST_IPV6_ADDR_COUNT=3
CONFIG_NET_IF_MCAST_IPV6_ADDR_COUNT=2
CONFIG_NET_APP_INIT_TIMEOUT=0

# bluetooth settings
CONFIG_BT_RX_BUF_COUNT=10
CONFIG_BT_RX_BUF_LEN=128
CONFIG_BT_CTLR_RX_BUFFERS=6
CONFIG_BT_CTLR_TX_BUFFERS=7
CONFIG_BT_RX_STACK_SIZE=2048
CONFIG_BT_L2CAP_TX_BUF_COUNT=6

# HW settings
CONFIG_TEXT_SECTION_OFFSET=0x100
# CONFIG_I2C is not set

# PWM
CONFIG_PWM_STM32_3=y
CONFIG_PWM_STM32_3_DEV_NAME="PWM_3"

# APP
CONFIG_APP_PWM_WHITE_DEV="PWM_3"
CONFIG_APP_PWM_WHITE_PIN=1
CONFIG_APP_PWM_RED_DEV="PWM_3"
CONFIG_APP_PWM_RED_PIN=2
CONFIG_APP_PWM_GREEN_DEV="PWM_3"
CONFIG_APP_PWM_GREEN_PIN=3
CONFIG_APP_PWM_BLUE_DEV="PWM_3"
CONFIG_APP_PWM_BLUE_PIN=4

# Default IP configuration for IPv6 (gateway)
CONFIG_NET_APP_PEER_IPV6_ADDR="fe80::d4e7:0:0:1"

# LWM2M (gateway)
CONFIG_LWM2M_FIRMWARE_UPDATE_PULL_COAP_PROXY_ADDR="coap://[fe80::d4e7:0:0:1]:5682"
```

## boards/nrf52840_pca10056.conf
```kconfig
# network stack settings
CONFIG_NET_IF_UNICAST_IPV6_ADDR_COUNT=3
CONFIG_NET_IF_MCAST_IPV6_ADDR_COUNT=2
CONFIG_NET_APP_INIT_TIMEOUT=0

# bluetooth settings
CONFIG_BT_RX_BUF_COUNT=10
CONFIG_BT_RX_BUF_LEN=128
CONFIG_BT_CTLR_RX_BUFFERS=6
CONFIG_BT_CTLR_TX_BUFFERS=7
CONFIG_BT_RX_STACK_SIZE=2048
CONFIG_BT_L2CAP_TX_BUF_COUNT=6

# HW settings
CONFIG_TEXT_SECTION_OFFSET=0x100
```

## boards/nrf52_blenano2.conf
```kconfig
# network stack settings
CONFIG_NET_IF_UNICAST_IPV6_ADDR_COUNT=3
CONFIG_NET_IF_MCAST_IPV6_ADDR_COUNT=2
CONFIG_NET_APP_INIT_TIMEOUT=0

# bluetooth settings
CONFIG_BT_RX_BUF_COUNT=10
CONFIG_BT_RX_BUF_LEN=128
CONFIG_BT_CTLR_RX_BUFFERS=6
CONFIG_BT_CTLR_TX_BUFFERS=7
CONFIG_BT_RX_STACK_SIZE=2048
CONFIG_BT_L2CAP_TX_BUF_COUNT=6

# HW settings
CONFIG_TEXT_SECTION_OFFSET=0x100

# temp settings
CONFIG_TEMP_NRF5_NAME="fota-mcu-temp"

# PWM
CONFIG_PWM_NRF5_SW_0_DEV_NAME="PWM_0"

# APP
CONFIG_APP_PWM_WHITE_DEV="PWM_0"
CONFIG_APP_PWM_WHITE_PIN=5
CONFIG_APP_PWM_RED_DEV="PWM_0"
CONFIG_APP_PWM_RED_PIN=6
CONFIG_APP_PWM_GREEN_DEV="PWM_0"
CONFIG_APP_PWM_GREEN_PIN=7
CONFIG_APP_PWM_BLUE_DEV="PWM_0"
CONFIG_APP_PWM_BLUE_PIN=8

# Default IP configuration for IPv6 (gateway)
CONFIG_NET_APP_PEER_IPV6_ADDR="fe80::d4e7:0:0:1"

# LWM2M (gateway)
CONFIG_LWM2M_FIRMWARE_UPDATE_PULL_COAP_PROXY_ADDR="coap://[fe80::d4e7:0:0:1]:5682"
```

## src/main.c
```c
/*
 * Copyright (c) 2016-2017 Linaro Limited
 *
 * SPDX-License-Identifier: Apache-2.0
 */

#define SYS_LOG_DOMAIN "fota/main"
#define SYS_LOG_LEVEL SYS_LOG_LEVEL_DEBUG
#include <logging/sys_log.h>

#include <zephyr.h>
#include <sensor.h>
#include <board.h>
#include <gpio.h>
#include <pwm.h>
#include <net/lwm2m.h>
#include <tc_util.h>

/* Local helpers and functions */
#include "tstamp_log.h"
#include "app_work_queue.h"
#include "mcuboot.h"
#include "product_id.h"
#include "lwm2m.h"

/* Defines and configs for the IPSO elements */
#define MCU_TEMP_DEV		"fota-mcu-temp"

static struct device *mcu_dev;
static struct float32_value temp_float;

struct device *flash_dev;

static int read_temperature(struct device *temp_dev,
			    struct float32_value *float_val)
{
	__unused const char *name = temp_dev->config->name;
	struct sensor_value temp_val;
	int ret;

	ret = sensor_sample_fetch(temp_dev);
	if (ret) {
		SYS_LOG_ERR("%s: I/O error: %d", name, ret);
		return ret;
	}

	ret = sensor_channel_get(temp_dev, SENSOR_CHAN_TEMP, &temp_val);
	if (ret) {
		SYS_LOG_ERR("%s: can't get data: %d", name, ret);
		return ret;
	}

	SYS_LOG_DBG("%s: read %d.%d C",
			name, temp_val.val1, temp_val.val2);
	float_val->val1 = temp_val.val1;
	float_val->val2 = temp_val.val2;

	return 0;
}

static void *temp_read_cb(u16_t obj_inst_id, size_t *data_len)
{
	/* Only object instance 0 is currently used */
	if (obj_inst_id != 0) {
		*data_len = 0;
		return NULL;
	}

	/*
	 * No need to check if read was successful, just reuse the
	 * previous value which is already stored at temp_float.
	 * This is because there is currently no way to report read_cb
	 * failures to the LWM2M engine.
	 */
	read_temperature(mcu_dev, &temp_float);
	*data_len = sizeof(temp_float);

	return &temp_float;
}

static int init_temp_device(void)
{
	mcu_dev = device_get_binding(MCU_TEMP_DEV);
	SYS_LOG_INF("%s MCU temperature sensor %s",
			mcu_dev ? "Found" : "Did not find",
			MCU_TEMP_DEV);

	if (!mcu_dev) {
		SYS_LOG_ERR("No temperature device found.");
		return -ENODEV;
	}

	return 0;
}

/* Color Unit used by the IPSO object */
#define COLOR_UNIT	"hex"
#define COLOR_WHITE	"#FFFFFF"

/* 100 is more than enough for it to be flicker free */
#define PWM_PERIOD (USEC_PER_SEC / 100)

/* Initial dimmer value (%) */
#define DIMMER_INITIAL	50

/* Support for up to 4 PWM devices */
#if defined(CONFIG_APP_PWM_WHITE)
static struct device *pwm_white;
static u8_t white_current;
#endif
#if defined(CONFIG_APP_PWM_RED)
static struct device *pwm_red;
#endif
#if defined(CONFIG_APP_PWM_GREEN)
static struct device *pwm_green;
#endif
#if defined(CONFIG_APP_PWM_BLUE)
static struct device *pwm_blue;
#endif

static u8_t color_rgb[3];

static u8_t char_to_nibble(char c)
{
	if (c >= '0' && c <= '9') {
		return c - '0';
	}
	if (c >= 'a' && c <= 'f') {
		return c - 'a' + 10U;
	}
	if (c >= 'A' && c <= 'F') {
		return c - 'A' + 10U;
	}
	return 15U;
}

static u32_t scale_pulse(u8_t level, u8_t ceiling)
{
	if (level && ceiling) {
		/* Scale level based on ceiling and return period */
		return PWM_PERIOD / 255 * level * ceiling / 255;
	}

	return 0;
}

static int write_pwm_pin(struct device *pwm_dev, u32_t pwm_pin,
			 u8_t level, u8_t ceiling)
{
	u32_t pulse = scale_pulse(level, ceiling);

	SYS_LOG_DBG("Set PWM %d: level %d, ceiling %d, pulse %lu",
				pwm_pin, level, ceiling, pulse);

	return pwm_pin_set_usec(pwm_dev, pwm_pin, PWM_PERIOD, pulse);
}

static int update_pwm(u8_t *color_rgb, u8_t dimmer)
{
	u8_t rgb[3];
	int i, ret = 0;

	memcpy(&rgb, color_rgb, 3);

	if (dimmer < 0) {
		dimmer = 0;
	}
	if (dimmer > 100) {
		dimmer = 100;
	}

#if defined(CONFIG_APP_PWM_WHITE)
	u8_t white = 0;

	/* If a dedicated PWM is used for white, zero RGB */
	if (rgb[0] == 0xFF && rgb[1] == 0xFF && rgb[2] == 0xFF) {
		rgb[0] = rgb[1] = rgb[2] = 0;
		white = 255;
	}

	/*
	 * If switching from white->color we first need to disable white to
	 * avoid consuming 4 PWM pins (required for nRF5 devices).
	 */
	if (!white && white_current) {
		white_current = 0;
		ret = write_pwm_pin(pwm_white, CONFIG_APP_PWM_WHITE_PIN, 0, 0);
		if (ret) {
			SYS_LOG_ERR("Failed to update white PWM");
			return ret;
		}
	}
#endif

	/*
	 * Update individual color values based on dimmer.
	 *
	 * This is just a direct map between dimmer and PWM, but not the best
	 * way to control the light brightness, as the human eye perceives
	 * it differently, but good enough for now as it is a simple method.
	 */
	for (i = 0; i < 3; i++) {
		rgb[i] = rgb[i] * dimmer / 100;
	}

#if defined(CONFIG_APP_PWM_RED)
	ret = write_pwm_pin(pwm_red, CONFIG_APP_PWM_RED_PIN,
				rgb[0], CONFIG_APP_PWM_RED_PIN_CEILING);
	if (ret) {
		SYS_LOG_ERR("Failed to update red PWM");
		return ret;
	}
#endif

#if defined(CONFIG_APP_PWM_GREEN)
	ret = write_pwm_pin(pwm_green, CONFIG_APP_PWM_GREEN_PIN,
				rgb[1], CONFIG_APP_PWM_GREEN_PIN_CEILING);
	if (ret) {
		SYS_LOG_ERR("Failed to update green PWM");
		return ret;
	}
#endif

#if defined(CONFIG_APP_PWM_BLUE)
	ret = write_pwm_pin(pwm_blue, CONFIG_APP_PWM_BLUE_PIN,
				rgb[2], CONFIG_APP_PWM_BLUE_PIN_CEILING);
	if (ret) {
		SYS_LOG_ERR("Failed to update blue PWM");
		return ret;
	}
#endif

#if defined(CONFIG_APP_PWM_WHITE)
	white = white * dimmer / 100;
	if (white != white_current) {
		white_current = white;
		ret = write_pwm_pin(pwm_white, CONFIG_APP_PWM_WHITE_PIN, white,
					CONFIG_APP_PWM_WHITE_PIN_CEILING);
		if (ret) {
			SYS_LOG_ERR("Failed to update white PWM");
			return ret;
		}
	}
#endif

	return ret;
}

/* TODO: Move to a pre write hook that can handle ret codes once available */
static int color_cb(u16_t obj_inst_id, u8_t *data, u16_t data_len,
		     bool last_block, size_t total_size)
{
	int i, ret = 0;
	bool on_off;
	u8_t dimmer;
	char *color;

	color = (char *) data;

	/* Check if just HEX and #HEX */
	if (data_len < 6 || data_len > 7) {
		SYS_LOG_ERR("Invalid color length (%s)", color);
		return -EINVAL;
	}
	if (data_len == 7 && *color != '#') {
		SYS_LOG_ERR("Invalid color format (%s)", color);
		return -EINVAL;
	}

	/* Skip '#' if available */
	if (data_len == 7) {
		color += 1;
	}

	for (i = 0; i < 3; i++) {
		color_rgb[i] = (char_to_nibble(*color) << 4) |
					char_to_nibble(*(color + 1));
		color += 2;
	}

	SYS_LOG_DBG("RGB color updated to #%02x%02x%02x", color_rgb[0],
					color_rgb[1], color_rgb[2]);

	/* Update PWM output if light is 'on' */
	on_off = lwm2m_engine_get_bool("3311/0/5850");
	if (on_off) {
		dimmer = lwm2m_engine_get_u8("3311/0/5851");
		ret = update_pwm(color_rgb, dimmer);
		if (ret) {
			SYS_LOG_ERR("Failed to update color");
			return ret;
		}
	}

	return ret;
}

/* TODO: Move to a pre write hook that can handle ret codes once available */
static int dimmer_cb(u16_t obj_inst_id, u8_t *data, u16_t data_len,
		     bool last_block, size_t total_size)
{
	int ret = 0;
	bool on_off;
	u8_t dimmer;

	dimmer = *(u8_t *) data;
	if (dimmer < 0) {
		SYS_LOG_ERR("Invalid dimmer value, forcing it to 0");
		dimmer = 0;
	}
	if (dimmer > 100) {
		SYS_LOG_ERR("Invalid dimmer value, forcing it to 100");
		dimmer = 100;
	}

	/* Update PWM output if light is 'on' */
	on_off = lwm2m_engine_get_bool("3311/0/5850");
	if (on_off) {
		ret = update_pwm(color_rgb, dimmer);
		if (ret) {
			SYS_LOG_ERR("Failed to update dimmer");
			return ret;
		}
	}

	return ret;
}

/* TODO: Move to a pre write hook that can handle ret codes once available */
static int on_off_cb(u16_t obj_inst_id, u8_t *data, u16_t data_len,
			 bool last_block, size_t total_size)
{
	int ret = 0;
	u8_t on_off, dimmer = 0;

	on_off = *(u8_t *) data;
	if (on_off) {
		dimmer = lwm2m_engine_get_u8("3311/0/5851");
	}

	ret = update_pwm(color_rgb, dimmer);
	if (ret) {
		SYS_LOG_ERR("Failed to update light state");
		return ret;
	}

	/* TODO: Move to be set by the IPSO object itself */
	lwm2m_engine_set_s32("3311/0/5852", 0);

	return ret;
}

static int init_pwm_devices(void)
{
#if defined(CONFIG_APP_PWM_WHITE)
	pwm_white = device_get_binding(CONFIG_APP_PWM_WHITE_DEV);
	if (!pwm_white) {
		SYS_LOG_ERR("Failed to get PWM device used for white");
		return -ENODEV;
	}
#endif
#if defined(CONFIG_APP_PWM_RED)
	pwm_red = device_get_binding(CONFIG_APP_PWM_RED_DEV);
	if (!pwm_red) {
		SYS_LOG_ERR("Failed to get PWM device used for red");
		return -ENODEV;
	}
#endif
#if defined(CONFIG_APP_PWM_GREEN)
	pwm_green = device_get_binding(CONFIG_APP_PWM_GREEN_DEV);
	if (!pwm_green) {
		SYS_LOG_ERR("Failed to get PWM device used for green");
		return -ENODEV;
	}
#endif
#if defined(CONFIG_APP_PWM_BLUE)
	pwm_blue = device_get_binding(CONFIG_APP_PWM_BLUE_DEV);
	if (!pwm_blue) {
		SYS_LOG_ERR("Failed to get PWM device used for blue");
		return -ENODEV;
	}
#endif

	return 0;
}

void main(void)
{
	tstamp_hook_install();
	app_wq_init();

	/* Initial color: white */
	color_rgb[0] = color_rgb[1] = color_rgb[2] = 0xFF;

	SYS_LOG_INF("LWM2M Smart Light Bulb");
	SYS_LOG_INF("Device: %s, Serial: %x",
		    product_id_get()->name, product_id_get()->number);

	TC_PRINT("Initializing LWM2M IPSO Temperature Sensor\n");
		if (init_temp_device()) {
			_TC_END_RESULT(TC_FAIL, "init_temp_device");
			TC_END_REPORT(TC_FAIL);
			return;
		}
		lwm2m_engine_create_obj_inst("3303/0");
		lwm2m_engine_register_read_callback("3303/0/5700", temp_read_cb);
		lwm2m_engine_set_string("3303/0/5701", "Cel");
		_TC_END_RESULT(TC_PASS, "init_temp_device");

	TC_PRINT("Initializing PWM devices\n");
	if (init_pwm_devices()) {
		_TC_END_RESULT(TC_FAIL, "init_pwm_devices");
		TC_END_REPORT(TC_FAIL);
		return;
	}
	_TC_END_RESULT(TC_PASS, "init_pwm_devices");

	TC_PRINT("Initializing LWM2M IPSO Light Control\n");
	if (lwm2m_engine_create_obj_inst("3311/0")) {
		_TC_END_RESULT(TC_FAIL, "init_ipso_light");
		TC_END_REPORT(TC_FAIL);
		return;
	}
	if (lwm2m_engine_register_post_write_callback("3311/0/5850",
				on_off_cb)) {
		_TC_END_RESULT(TC_FAIL, "init_ipso_light");
		TC_END_REPORT(TC_FAIL);
		return;
	}
	if (lwm2m_engine_set_u8("3311/0/5851", DIMMER_INITIAL)) {
		_TC_END_RESULT(TC_FAIL, "init_ipso_light");
		TC_END_REPORT(TC_FAIL);
		return;
	}
	if (lwm2m_engine_register_post_write_callback("3311/0/5851",
				dimmer_cb)) {
		_TC_END_RESULT(TC_FAIL, "init_ipso_light");
		TC_END_REPORT(TC_FAIL);
		return;
	}
	if (lwm2m_engine_set_string("3311/0/5701", COLOR_UNIT)) {
		_TC_END_RESULT(TC_FAIL, "init_ipso_light");
		TC_END_REPORT(TC_FAIL);
		return;
	}
	if (lwm2m_engine_set_string("3311/0/5706", COLOR_WHITE)) {
		_TC_END_RESULT(TC_FAIL, "init_ipso_light");
		TC_END_REPORT(TC_FAIL);
		return;
	}
	if (lwm2m_engine_register_post_write_callback("3311/0/5706",
				color_cb)) {
		_TC_END_RESULT(TC_FAIL, "init_ipso_light");
		TC_END_REPORT(TC_FAIL);
		return;
	}
	_TC_END_RESULT(TC_PASS, "init_ipso_light");
	TC_END_REPORT(TC_PASS);

	/* Set initial light state based on DIMMER_INITIAL */
	lwm2m_engine_set_bool("3311/0/5850", true);

	if (lwm2m_init()) {
		return;
	}

	/*
	 * From this point on, just handle work.
	 */
	app_wq_run();
}
```

## src/bluetooth.c
```c
/*
 * Copyright (c) 2016-2017 Linaro Limited
 *
 * SPDX-License-Identifier: Apache-2.0
 */

#define SYS_LOG_DOMAIN "fota/bluetooth"
#define SYS_LOG_LEVEL SYS_LOG_LEVEL_DEBUG
#include <logging/sys_log.h>

#include <zephyr/types.h>
#include <stddef.h>
#include <errno.h>
#include <zephyr.h>
#include <gpio.h>
#include <misc/reboot.h>
#include <init.h>
#include <soc.h>
#include <board.h>

#include <bluetooth/bluetooth.h>
#include <bluetooth/hci.h>
#include <bluetooth/storage.h>
#include <bluetooth/conn.h>

#include "product_id.h"

/* Any by default, can change depending on the hardware implementation */
static bt_addr_le_t bt_addr;

static ssize_t storage_read(const bt_addr_le_t *addr, u16_t key, void *data,
			       size_t length)
{
	if (addr) {
		return -ENOENT;
	}

	if (key == BT_STORAGE_ID_ADDR && length == sizeof(bt_addr)) {
		bt_addr_le_copy(data, &bt_addr);
		return sizeof(bt_addr);
	}

	return -EIO;
}

static ssize_t storage_write(const bt_addr_le_t *addr, u16_t key,
				const void *data, size_t length)
{
	return -ENOSYS;
}

static ssize_t storage_clear(const bt_addr_le_t *addr)
{
	return -ENOSYS;
}

static void set_own_bt_addr(void)
{
	int i;
	u8_t tmp;

	/*
	 * Generate a static BT addr using the unique product number.
	 */
	for (i = 0; i < 4; i++) {
		tmp = (product_id_get()->number >> i * 8) & 0xff;
		bt_addr.a.val[i] = tmp;
	}

	bt_addr.a.val[4] = 0xe7;
	bt_addr.a.val[5] = 0xd6;
}

static int bt_storage_init(void)
{
	static const struct bt_storage storage = {
		.read = storage_read,
		.write = storage_write,
		.clear = storage_clear,
	};

	bt_addr.type = BT_ADDR_LE_RANDOM;

	set_own_bt_addr();

	bt_storage_register(&storage);

	SYS_LOG_DBG("Bluetooth storage driver registered");

	return 0;
}

/* BT LE Connect/Disconnect callbacks */
static void set_bluetooth_led(bool state)
{
#if defined(BT_GPIO_PIN) && defined(BT_GPIO_PORT)
	struct device *gpio = device_get_binding(BT_GPIO_PORT);
	gpio_pin_configure(gpio, BT_GPIO_PIN, GPIO_DIR_OUT);
	gpio_pin_write(gpio, BT_GPIO_PIN, state);
#elif defined(LED0_GPIO_PIN) && defined(LED0_GPIO_PORT)
	/* Use LED0 in case there is no dedicated LED for BT */
	struct device *gpio = device_get_binding(LED0_GPIO_PORT);
	gpio_pin_configure(gpio, LED0_GPIO_PIN, GPIO_DIR_OUT);
	gpio_pin_write(gpio, LED0_GPIO_PIN, state);
#endif
}

static void connected(struct bt_conn *conn, u8_t err)
{
	if (err) {
		SYS_LOG_ERR("BT LE Connection failed: %u", err);
	} else {
		SYS_LOG_INF("BT LE Connected");
		set_bluetooth_led(1);
	}
}

static void disconnected(struct bt_conn *conn, u8_t reason)
{
	SYS_LOG_ERR("BT LE Disconnected (reason %u), rebooting!", reason);
	set_bluetooth_led(0);
	sys_reboot(0);
}

static struct bt_conn_cb conn_callbacks = {
	.connected = connected,
	.disconnected = disconnected,
};

static int bt_network_init(struct device *dev)
{
	/* Storage used to provide a BT MAC based on the serial number */
	SYS_LOG_DBG("Setting Bluetooth MAC\n");
	bt_storage_init();
	bt_conn_cb_register(&conn_callbacks);
	return 0;
}

/* last priority in the POST_KERNEL init levels */
SYS_INIT(bt_network_init, APPLICATION, CONFIG_APPLICATION_INIT_PRIORITY);
```
