## Kconfig
```
# Copyright (c) 2017 Linaro Limited
#
# SPDX-License-Identifier: Apache-2.0
#

mainmenu "Linaro FOTA configuration"

config ZEPHYR_BASE
	string
	option env="ZEPHYR_BASE"

config APPLICATION_BASE
	string
	option env="PROJECT_BASE"

source "$ZEPHYR_BASE/Kconfig.zephyr"

config FOTA_DEVICE
	bool "Enable FOTA device settings"
	default y
	select FOTA_DEVICE_SOC_SERIES_KINETIS_K6X if SOC_SERIES_KINETIS_K6X
	select FOTA_DEVICE_SOC_SERIES_NRF52X if SOC_SERIES_NRF52X
	select FOTA_DEVICE_SOC_SERIES_STM32F4X if SOC_SERIES_STM32F4X
	help
	  Main config to enable device specific settings

config FOTA_DEVICE_SOC_SERIES_KINETIS_K6X
	bool "Kinetis K6x FOTA settings"
	select NET_L2_ETHERNET
	select NET_SHELL
	select NET_IPV4
	select NET_APP_NEED_IPV4
	default n

config FOTA_DEVICE_SOC_SERIES_NRF52X
	bool "Nordic Semiconductor nRF52 FOTA settings"
	select NET_L2_BT
	select NET_L2_BT_ZEP1656
	select NET_IPV6
	select NET_APP_NEED_IPV6
	select TEST_RANDOM_GENERATOR
	select PWM_NRF5_SW
	default n

config FOTA_DEVICE_SOC_SERIES_STM32F4X
	bool "STM32F4x FOTA settings"
	select NET_L2_BT
	select NET_L2_BT_ZEP1656
	select NET_IPV6
	select NET_APP_NEED_IPV6
	select TEST_RANDOM_GENERATOR
	select PWM_STM32
	default n

config SYS_LOG_FOTA_LEVEL
	int "FOTA log level"
	depends on SYS_LOG && FOTA_DEVICE
	default 0
	range 0 4
	help
	  Set the log level for the FOTA library.

	  The available levels are:

	  - 0 OFF: do not write
	  - 1 ERROR: only write SYS_LOG_ERR
	  - 2 WARNING: write SYS_LOG_WRN in addition to previous level
	  - 3 INFO: write SYS_LOG_INF in addition to previous levels
	  - 4 DEBUG: write SYS_LOG_DBG in addition to previous levels

source "$APPLICATION_BASE/Kconfig.app"
```

## Kconfig.app
```
# Copyright (c) 2017 Linaro Limited
#
# SPDX-License-Identifier: Apache-2.0
#

config APP_PWM_WHITE
	bool
	prompt "Enable dedicated PWM for white color"
	default y

if APP_PWM_WHITE

config APP_PWM_WHITE_DEV
	string
	prompt "PWM device name used for white"

config APP_PWM_WHITE_PIN
	int
	prompt "PWM pin number used for white"
	default 0

endif # APP_PWM_WHITE

config APP_PWM_RED
	bool
	prompt "Enable dedicated PWM for red"
	default n

if APP_PWM_RED

config APP_PWM_RED_DEV
	string
	prompt "PWM device name used for red"

config APP_PWM_RED_PIN
	int
	prompt "PWM pin number used for red"
	default 0

endif # APP_PWM_RED

config APP_PWM_GREEN
	bool
	prompt "Enable dedicated PWM for green"
	default n

if APP_PWM_GREEN

config APP_PWM_GREEN_DEV
	string
	prompt "PWM device name used for green"

config APP_PWM_GREEN_PIN
	int
	prompt "PWM pin number used for green"
	default 0

endif # APP_PWM_GREEN

config APP_PWM_BLUE
	bool
	prompt "Enable dedicated PWM for blue"
	default n

if APP_PWM_BLUE

config APP_PWM_BLUE_DEV
	string
	prompt "PWM device name used for blue"

config APP_PWM_BLUE_PIN
	int
	prompt "PWM pin number used for blue"
	default 0

endif # APP_PWM_BLUE
```

## prj.conf
```kconfig
CONFIG_BOOT_BANNER=y
CONFIG_BUILD_TIMESTAMP=y
CONFIG_REBOOT=y
CONFIG_FLASH=y
CONFIG_NETWORKING=y

# Leave device specific settings to enable IPV*
CONFIG_NET_IPV6=n
CONFIG_NET_IPV4=n

# Network
CONFIG_NET_UDP=y
CONFIG_NET_MGMT=y
CONFIG_NET_MGMT_EVENT=y
CONFIG_NET_CONTEXT_NET_PKT_POOL=y
CONFIG_NET_RX_STACK_SIZE=2048
CONFIG_NET_PKT_RX_COUNT=10
CONFIG_NET_PKT_TX_COUNT=10
CONFIG_NET_BUF_RX_COUNT=10
CONFIG_NET_BUF_TX_COUNT=10
CONFIG_NET_BUF_DATA_SIZE=384

# General
CONFIG_MINIMAL_LIBC_EXTENDED=y

# FOTA
CONFIG_FOTA_DEVICE=y

# APP
CONFIG_HEAP_MEM_POOL_SIZE=256

# NET APP
CONFIG_NET_APP=y
CONFIG_NET_APP_INIT_TIMEOUT=0
CONFIG_NET_APP_NEED_IPV6=n
CONFIG_NET_APP_NEED_IPV4=n
CONFIG_NET_APP_CLIENT=y
CONFIG_NET_APP_SETTINGS=y
CONFIG_NET_APP_BT_NODE=y
CONFIG_BT_DEVICE_NAME="Linaro IPSP node"

# PWM
CONFIG_PWM=y
#CONFIG_SYS_LOG_PWM_LEVEL=4

# LWM2M
CONFIG_LWM2M=y
CONFIG_LWM2M_RD_CLIENT_INSTANCE_COUNT=1
CONFIG_LWM2M_ENGINE_MAX_OBSERVER=20
CONFIG_LWM2M_SERVER_INSTANCE_COUNT=2
# CONFIG_LWM2M_RW_JSON_SUPPORT is not set
CONFIG_LWM2M_COAP_BLOCK_SIZE=256
CONFIG_LWM2M_FIRMWARE_UPDATE_PULL_COAP_PROXY_SUPPORT=y
CONFIG_LWM2M_IPSO_SUPPORT=y
CONFIG_LWM2M_IPSO_LIGHT_CONTROL=y
CONFIG_SYS_LOG_LWM2M_LEVEL=3

# Logging
CONFIG_SYS_LOG=y
CONFIG_SYS_LOG_SHOW_COLOR=y
CONFIG_SYS_LOG_EXT_HOOK=y
CONFIG_SYS_LOG_FOTA_LEVEL=4

# Bluetooth (when enabled) debug
#CONFIG_BT_DEBUG_LOG=y
#CONFIG_BT_DEBUG_HCI_DRIVER=y

# Add flash RW to MPU
CONFIG_MPU_ALLOW_FLASH_WRITE=y

# Debug helpers
#CONFIG_NET_LOG=y
#CONFIG_SYS_LOG_NET_LEVEL=4
#CONFIG_NET_DEBUG_CORE=y
#CONFIG_NET_DEBUG_NET_APP=y
#CONFIG_NET_DEBUG_IF=y
#CONFIG_NET_DEBUG_UTILS=y
#CONFIG_NET_DEBUG_CONTEXT=y
#CONFIG_NET_DEBUG_NET_PKT=y
#CONFIG_NET_DEBUG_NET_PKT_ALL=y
#CONFIG_NET_DEBUG_CONN=y
#CONFIG_NET_DEBUG_ROUTE=y
#CONFIG_NET_DEBUG_IPV4=y
#CONFIG_NET_DEBUG_IPV6=y
#CONFIG_NET_DEBUG_ICMPV6=y
#CONFIG_NET_DEBUG_IPV6_NBR_CACHE=y
#CONFIG_NET_DEBUG_6LO=y
#CONFIG_NET_DEBUG_UDP=y
#CONFIG_NET_DEBUG_L2_ETHERNET=y
#CONFIG_NET_DEBUG_L2_BT=y
#CONFIG_INIT_STACKS=y
#CONFIG_STACK_USAGE=y
```

## boards/96b_carbon.conf
```kconfig
# network stack settings
CONFIG_NET_IF_UNICAST_IPV6_ADDR_COUNT=3
CONFIG_NET_IF_MCAST_IPV6_ADDR_COUNT=2
CONFIG_NET_APP_INIT_TIMEOUT=0

# bluetooth settings
CONFIG_BT_RX_BUF_COUNT=10
CONFIG_BT_RX_BUF_LEN=128
CONFIG_BT_CTLR_RX_BUFFERS=6
CONFIG_BT_CTLR_TX_BUFFERS=7
CONFIG_BT_RX_STACK_SIZE=2048
CONFIG_BT_L2CAP_TX_BUF_COUNT=6

# HW settings
CONFIG_TEXT_SECTION_OFFSET=0x100

# PWM
CONFIG_PWM_STM32_3=y
CONFIG_PWM_STM32_3_DEV_NAME="PWM_3"

# APP
CONFIG_APP_PWM_WHITE_DEV="PWM_3"
CONFIG_APP_PWM_WHITE_PIN=1
CONFIG_APP_PWM_RED_DEV="PWM_3"
CONFIG_APP_PWM_RED_PIN=2
CONFIG_APP_PWM_GREEN_DEV="PWM_3"
CONFIG_APP_PWM_GREEN_PIN=3
CONFIG_APP_PWM_BLUE_DEV="PWM_3"
CONFIG_APP_PWM_BLUE_PIN=4

# Default IP configuration for IPv6 (gateway)
CONFIG_NET_APP_PEER_IPV6_ADDR="fe80::d4e7:0:0:1"

# LWM2M (gateway)
CONFIG_LWM2M_FIRMWARE_UPDATE_PULL_COAP_PROXY_ADDR="coap://[fe80::d4e7:0:0:1]:5682"
```

## boards/96b_nitrogen.conf
```kconfig
# network stack settings
CONFIG_NET_IF_UNICAST_IPV6_ADDR_COUNT=3
CONFIG_NET_IF_MCAST_IPV6_ADDR_COUNT=2
CONFIG_NET_APP_INIT_TIMEOUT=0

# bluetooth settings
CONFIG_BT_RX_BUF_COUNT=10
CONFIG_BT_RX_BUF_LEN=128
CONFIG_BT_CTLR_RX_BUFFERS=6
CONFIG_BT_CTLR_TX_BUFFERS=7
CONFIG_BT_RX_STACK_SIZE=2048
CONFIG_BT_L2CAP_TX_BUF_COUNT=6

# HW settings
CONFIG_TEXT_SECTION_OFFSET=0x100

# PWM
CONFIG_PWM_NRF5_SW_0_DEV_NAME="PWM_0"

# APP
CONFIG_APP_PWM_WHITE_DEV="PWM_0"
CONFIG_APP_PWM_WHITE_PIN=4
CONFIG_APP_PWM_RED_DEV="PWM_0"
CONFIG_APP_PWM_RED_PIN=5
CONFIG_APP_PWM_GREEN_DEV="PWM_0"
CONFIG_APP_PWM_GREEN_PIN=6
CONFIG_APP_PWM_BLUE_DEV="PWM_0"
CONFIG_APP_PWM_BLUE_PIN=7

# Default IP configuration for IPv6 (gateway)
CONFIG_NET_APP_PEER_IPV6_ADDR="fe80::d4e7:0:0:1"

# LWM2M (gateway)
CONFIG_LWM2M_FIRMWARE_UPDATE_PULL_COAP_PROXY_ADDR="coap://[fe80::d4e7:0:0:1]:5682"
```

## boards/frdm_k64f.conf
```kconfig
# network stack settings
CONFIG_NET_IF_UNICAST_IPV4_ADDR_COUNT=3
CONFIG_NET_IF_MCAST_IPV4_ADDR_COUNT=2
CONFIG_NET_ARP_TABLE_SIZE=10

# HW settings
CONFIG_TEXT_SECTION_OFFSET=0x200
```

## boards/nrf52840_pca10056.conf
```kconfig
# network stack settings
CONFIG_NET_IF_UNICAST_IPV6_ADDR_COUNT=3
CONFIG_NET_IF_MCAST_IPV6_ADDR_COUNT=2

# bluetooth settings
CONFIG_BT_RX_BUF_COUNT=10
CONFIG_BT_RX_BUF_LEN=128
CONFIG_BT_CTLR_RX_BUFFERS=6
CONFIG_BT_CTLR_TX_BUFFERS=7
CONFIG_BT_RX_STACK_SIZE=2048
CONFIG_BT_L2CAP_TX_BUF_COUNT=6

# HW settings
CONFIG_TEXT_SECTION_OFFSET=0x100
```

## boards/nrf52_blenano2.conf
```kconfig
# network stack settings
CONFIG_NET_IF_UNICAST_IPV6_ADDR_COUNT=3
CONFIG_NET_IF_MCAST_IPV6_ADDR_COUNT=2
CONFIG_NET_APP_INIT_TIMEOUT=0

# bluetooth settings
CONFIG_BT_RX_BUF_COUNT=10
CONFIG_BT_RX_BUF_LEN=128
CONFIG_BT_CTLR_RX_BUFFERS=6
CONFIG_BT_CTLR_TX_BUFFERS=7
CONFIG_BT_RX_STACK_SIZE=2048
CONFIG_BT_L2CAP_TX_BUF_COUNT=6

# HW settings
CONFIG_TEXT_SECTION_OFFSET=0x100

# PWM
CONFIG_PWM_NRF5_SW_0_DEV_NAME="PWM_0"

# APP
CONFIG_APP_PWM_WHITE_DEV="PWM_0"
CONFIG_APP_PWM_WHITE_PIN=5
CONFIG_APP_PWM_RED_DEV="PWM_0"
CONFIG_APP_PWM_RED_PIN=6
CONFIG_APP_PWM_GREEN_DEV="PWM_0"
CONFIG_APP_PWM_GREEN_PIN=7
CONFIG_APP_PWM_BLUE_DEV="PWM_0"
CONFIG_APP_PWM_BLUE_PIN=8

# Default IP configuration for IPv6 (gateway)
CONFIG_NET_APP_PEER_IPV6_ADDR="fe80::d4e7:0:0:1"

# LWM2M (gateway)
CONFIG_LWM2M_FIRMWARE_UPDATE_PULL_COAP_PROXY_ADDR="coap://[fe80::d4e7:0:0:1]:5682"
```

## src/main.c
```c
/*
 * Copyright (c) 2016-2017 Linaro Limited
 *
 * SPDX-License-Identifier: Apache-2.0
 */

#define SYS_LOG_DOMAIN "fota/main"
#define SYS_LOG_LEVEL SYS_LOG_LEVEL_DEBUG
#include <logging/sys_log.h>

#include <zephyr.h>
#include <board.h>
#include <gpio.h>
#include <net/lwm2m.h>
#include <tc_util.h>

/* Local helpers and functions */
#include "tstamp_log.h"
#include "app_work_queue.h"
#include "mcuboot.h"
#include "product_id.h"
#include "lwm2m.h"
#include "neopixel.h"
#include "nrf_pwm.h"

/* Color Unit used by the IPSO object */
#define COLOR_UNIT	"hex"
#define COLOR_WHITE	"#FFFFFF"

/* Magic Timing Values */
#define MAGIC_T0H               6UL | (0x8000)
#define MAGIC_T1H              13UL | (0x8000)
#define CTOPVAL                20UL

#define NUMBYTES NEOPIXEL_COUNT * 4

/* Initial dimmer value (%) */
#define DIMMER_INITIAL	15

struct device *flash_dev;
NRF_PWM_Type* pwm = NULL;
struct device *gpio = NULL;
uint32_t pattern_size  = NUMBYTES*8*sizeof(uint16_t)+2*sizeof(uint16_t);
uint32_t *pixels_pattern = NULL;

int neopixel_update_leds(uint8_t bit, uint32_t pattern_size, uint16_t loops, u8_t refresh)
{
	int ret = 0;
	uint16_t pos = 0;

        if ((pixels_pattern != NULL) && (pwm != NULL))
        {
                for( uint16_t n=0; n<loops; n++ )
                {
			for(uint8_t mask=0x80, i=0; mask>0; mask >>= 1, i++)
			{
				if (bit)
					pixels_pattern[pos] = MAGIC_T1H;
				else
					pixels_pattern[pos] = MAGIC_T0H;
			}
                        pos++;
                }
        } else {
                SYS_LOG_ERR("Pixel Pattern is NULL!");
                ret = 1;
                return ret;
        }

        pixels_pattern[++pos] = 0 | (0x8000); // Seq end
        pixels_pattern[++pos] = 0 | (0x8000); // Seq end

	pwm->MODE = (PWM_MODE_UPDOWN_Up << PWM_MODE_UPDOWN_Pos);

	pwm->PRESCALER = (PWM_PRESCALER_PRESCALER_DIV_1 << PWM_PRESCALER_PRESCALER_Pos);

	pwm->COUNTERTOP = (CTOPVAL << PWM_COUNTERTOP_COUNTERTOP_Pos);

	pwm->LOOP = (PWM_LOOP_CNT_Disabled << PWM_LOOP_CNT_Pos);

	pwm->DECODER = (PWM_DECODER_LOAD_Common << PWM_DECODER_LOAD_Pos) |
                       (PWM_DECODER_MODE_RefreshCount << PWM_DECODER_MODE_Pos);

        pwm->SEQ[0].PTR = (uint32_t)(pixels_pattern) << PWM_SEQ_PTR_PTR_Pos;

        pwm->SEQ[0].CNT = (pattern_size/sizeof(uint16_t)) << PWM_SEQ_CNT_CNT_Pos;

        pwm->SEQ[0].REFRESH  = refresh;
        pwm->SEQ[0].ENDDELAY = 0;

        pwm->PSEL.OUT[0] = NEOPIXEL_PWM_PIN;

        pwm->ENABLE = 1;

        pwm->EVENTS_SEQEND[0]  = 0;
        pwm->TASKS_SEQSTART[0] = 1;

        while(!pwm->EVENTS_SEQEND[0]);

        pwm->EVENTS_SEQEND[0] = 0;

        pwm->ENABLE = 0;

        pwm->PSEL.OUT[0] = 0xFFFFFFFFUL;

	return ret;
}

static int dimmer_cb(u16_t obj_inst_id, u8_t *data, u16_t data_len,
		     bool last_block, size_t total_size)
{
	int ret = 0;
	u8_t dimmer;

	dimmer = *(u8_t *) data;
	if (dimmer < 0) {
		static uint8_t bit = 1;
		neopixel_update_leds(bit, pattern_size, NUMBYTES, dimmer);
	} else {
		static uint8_t bit = 0;
		neopixel_update_leds(bit, pattern_size, NUMBYTES, dimmer);
	}
	return ret;
}

/* TODO: Move to a pre write hook that can handle ret codes once available */
static int on_off_cb(u16_t obj_inst_id, u8_t *data, u16_t data_len,
                         bool last_block, size_t total_size)
{
        int ret = 0;
        u8_t on_off;

        on_off = *(u8_t *) data;
        if (on_off) {
                static uint8_t bit = 1;
		static u8_t refresh = 12;
		neopixel_update_leds(bit, pattern_size, NUMBYTES, refresh);
        } else {
		static uint8_t bit = 0;
		static uint8_t refresh = -1;
		neopixel_update_leds(bit, pattern_size, NUMBYTES, refresh);
	}

        if (ret) {
                SYS_LOG_ERR("Failed to update light state");
                return ret;
        }

        /* TODO: Move to be set by the IPSO object itself */
        lwm2m_engine_set_s32("3311/0/5852", 0);

        return ret;
}


static int init_pwm_device(void)
{
	/* Set the pin low */
	gpio = device_get_binding(NEOPIXEL_PWM_PORT);
	gpio_pin_configure(gpio, NEOPIXEL_PWM_PIN, GPIO_DIR_OUT);
	gpio_pin_write(gpio, NEOPIXEL_PWM_PIN, LOW);
	/* Set up the PWM */
	NRF_PWM_Type* PWM[3] = {NRF_PWM0, NRF_PWM1, NRF_PWM2};
	for(int device = 0; device<3; device++)
	{
		if( (PWM[device]->ENABLE == 0)                            &&
		    (PWM[device]->PSEL.OUT[0] & PWM_PSEL_OUT_CONNECT_Msk) &&
		    (PWM[device]->PSEL.OUT[1] & PWM_PSEL_OUT_CONNECT_Msk) &&
		    (PWM[device]->PSEL.OUT[2] & PWM_PSEL_OUT_CONNECT_Msk) &&
		    (PWM[device]->PSEL.OUT[3] & PWM_PSEL_OUT_CONNECT_Msk)
		  ) {
			pwm = PWM[device];
			break;
		}
	}

	if (pwm == NULL)
	{
		return 1;
	}

	return 0;
}

void main(void)
{
	tstamp_hook_install();
	app_wq_init();

	SYS_LOG_INF("LWM2M Smart Light Bulb");
	SYS_LOG_INF("Device: %s, Serial: %x",
		    product_id_get()->name, product_id_get()->number);

	pixels_pattern = (uint32_t *) k_malloc(sizeof(pattern_size));

	TC_PRINT("Initializing PWM device\n");
	if (init_pwm_device()) {
		_TC_END_RESULT(TC_FAIL, "init_pwm_device");
		TC_END_REPORT(TC_FAIL);
		return;
	}
	_TC_END_RESULT(TC_PASS, "init_pwm_device");
	
	TC_PRINT("Initializing LWM2M IPSO Light Control\n");
	if (lwm2m_engine_create_obj_inst("3311/0")) {
		_TC_END_RESULT(TC_FAIL, "init_ipso_light");
		TC_END_REPORT(TC_FAIL);
		return;
	}
	if (lwm2m_engine_register_post_write_callback("3311/0/5850",
				on_off_cb)) {
		_TC_END_RESULT(TC_FAIL, "init_ipso_light");
		TC_END_REPORT(TC_FAIL);
		return;
	}
	if (lwm2m_engine_set_bool("3311/0/5850", true)) {
		_TC_END_RESULT(TC_FAIL, "init_ipso_light");
		TC_END_REPORT(TC_FAIL);
		return;
	}
	if (lwm2m_engine_register_post_write_callback("3311/0/5851",
				dimmer_cb)) {
		_TC_END_RESULT(TC_FAIL, "init_ipso_light");
		TC_END_REPORT(TC_FAIL);
		return;
	}
	if (lwm2m_engine_set_u8("3311/0/5851", DIMMER_INITIAL)) {
		_TC_END_RESULT(TC_FAIL, "init_ipso_light");
		TC_END_REPORT(TC_FAIL);
		return;
	}
	_TC_END_RESULT(TC_PASS, "init_ipso_light");

	TC_PRINT("Initializing LWM2M Engine\n");
	if (lwm2m_init()) {
		_TC_END_RESULT(TC_FAIL, "lwm2m_init");
		TC_END_REPORT(TC_FAIL);
		return;
	}
	_TC_END_RESULT(TC_PASS, "lwm2m_init");

	TC_END_REPORT(TC_PASS);

	/*
	 * From this point on, just handle work.
	 */
	app_wq_run();
}
```

## src/neopixel.h
```c
/*
 * Copyright (c) 2017 Linaro Limited
 *
 * SPDX-License-Identifier: Apache-2.0
 */

#ifndef __FOTA_NEOPIXEL_H__
#define __FOTA_NEOPIXEL_H__

#include <gpio.h>

#define NEOPIXEL_PWM_PIN	5
#define NEOPIXEL_PWM_PORT	CONFIG_GPIO_NRF5_P0_DEV_NAME
	
#define NEOPIXEL_COUNT	12

#define LOW 0

#endif	/* __FOTA_NEOPIXEL_H__ */
```
